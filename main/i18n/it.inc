static const char *const lang_it[STR_COUNT] = {
    [STR_SETTINGS] = "Impostazioni",
    [STR_WIFI] = "Wi-Fi",
    [STR_FAIL] = "errore",
    [STR_TIMEZONE] = "Fuso orario",
    [STR_BRIGHTNESS] = "Luminosità",
    [STR_LED_BLINK] = "LED Lamp.",
    [STR_ROTATE] = "Ruota 180",
    [STR_ABOUT] = "Info",
    [STR_LANGUAGE] = "Lingua",
    [STR_DONE] = "Fatto",
    [STR_BACK] = "Torna",
    [STR_CANCEL] = "Annul.",
    [STR_DEL] = "Canc",
    [STR_RUNNING] = "In corso",
    [STR_ON] = "Sì",
    [STR_OFF] = "No",
    [STR_NTS_NO] = "No",
    [STR_NTS_ATTEMPT] = "Prova",
    [STR_NTS_REQUIRE] = "Richiedi",
    [STR_WAITING_NTP] = "Attesa NTP...",
    [STR_FMT_SYNCED] = "Sinc.: %s",
    [STR_FMT_SYNCING] = "Sinc...: %s",
    [STR_FMT_WAITING] = "Attesa: %lus",
    [STR_FMT_PEERS_NOSYNC] = "%d/%d srv  poll %s  non sinc",
    [STR_FMT_PEERS_AGO] = "%d/%d srv  poll %s  %s fa",
    [STR_WIFI_SETUP] = "Config. Wi-Fi",
    [STR_SCANNING] = "Scansione...",
    [STR_SCAN_FAILED] = "Scansione fallita",
    [STR_TAP_RETRY] = "Tocca per riprovare",
    [STR_SELECT_NETWORK] = "Scegli rete",
    [STR_NO_NETWORKS] = "Nessuna rete",
    [STR_NETWORK_LABEL] = "Rete:",
    [STR_ENTER_PASSWORD] = "Password",
    [STR_CONNECTING] = "Connessione",
    [STR_CONNECTING_TO] = "Connessione a",
    [STR_CONNECTED] = "Connesso!",
    [STR_CONNECTION_FAILED] = "Connessione fallita",
    [STR_KB_SHIFT] = "Mai",
    [STR_KB_SPACE] = "Spazio",
    [STR_KB_GO] = "Vai",
    [STR_VERSION] = "Ver.:",
    [STR_FIRMWARE_URL] = "URL firmware:",
    [STR_OTA_URL] = "URL OTA",
    [STR_STATUS] = "Stato:",
    [STR_READ] = "Letto:",
    [STR_UPDATE] = "Aggiorna",
    [STR_RESTARTING] = "Riavvio",
    [STR_OTA_UPDATE] = "Aggiorn. OTA",
    [STR_NTP_SERVER] = "Server NTP",
    [STR_SERVER_LABEL] = "Server:",
    [STR_NTP_SETTINGS] = "Impost. NTP",
    [STR_NTP_PRESETS] = "Preimp. NTP",
    [STR_PRESETS] = "Preimpostati",
    [STR_BENCHMARK] = "Misura",
    [STR_STOPPING] = "Arresto",
    [STR_NTP_STATS] = "Statistiche NTP",
    [STR_UNSYNCED] = "non sinc",
    [STR_SYNCS_LABEL] = "  Sinc: ",
    [STR_AGE_LABEL] = "  Età: ",
    [STR_NONE] = "nessuno",
    [STR_SELECT_REGION] = "Scegli regione",
    [STR_DST] = "ora legale",
    [STR_NO_DST] = "no ora legale",
};

static const char *const weekdays_it[7] = {
    "dom", "lun", "mar", "mer", "gio", "ven", "sab",
};

static const char *const months_it[12] = {
    "gen", "feb", "mar", "apr", "mag", "giu",
    "lug", "ago", "set", "ott", "nov", "dic",
};

static const char lang_name_it[] = "Italiano";
