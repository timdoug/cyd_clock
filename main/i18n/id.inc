static const char *const lang_id[STR_COUNT] = {
    [STR_SETTINGS] = "Pengaturan",
    [STR_WIFI] = "Wi-Fi",
    [STR_TIMEZONE] = "Zona waktu",
    [STR_BRIGHTNESS] = "Kecerahan",
    [STR_LED_BLINK] = "LED Kedip",
    [STR_ROTATE] = "Putar 180",
    [STR_ABOUT] = "Tentang",
    [STR_LANGUAGE] = "Bahasa",
    [STR_DONE] = "Selesai",
    [STR_BACK] = "Balik",
    [STR_CANCEL] = "Batal",
    [STR_DEL] = "Hapus",
    [STR_RUNNING] = "Berjalan",
    [STR_ON] = "Nyala",
    [STR_OFF] = "Mati",
    [STR_NTS_NO] = "Tidak",
    [STR_NTS_ATTEMPT] = "Coba",
    [STR_NTS_REQUIRE] = "Wajib",
    [STR_WAITING_NTP] = "Menunggu NTP...",
    [STR_FMT_SYNCED] = "Sinkron: %s",
    [STR_FMT_SYNCING] = "Menyinkronkan: %s",
    [STR_FMT_WAITING] = "Tunggu: %lus",
    [STR_FMT_PEERS_NOSYNC] = "%d/%d srv  poll %s  belum sync",
    [STR_FMT_PEERS_AGO] = "%d/%d srv  poll %s  %s lalu",
    [STR_WIFI_SETUP] = "Atur Wi-Fi",
    [STR_SCANNING] = "Memindai...",
    [STR_SCAN_FAILED] = "Pindai gagal",
    [STR_TAP_RETRY] = "Ketuk utk ulang",
    [STR_SELECT_NETWORK] = "Pilih jaringan",
    [STR_NO_NETWORKS] = "Tidak ada jaringan",
    [STR_NETWORK_LABEL] = "Jaringan:",
    [STR_ENTER_PASSWORD] = "Masukkan sandi",
    [STR_CONNECTING] = "Menyambung",
    [STR_CONNECTING_TO] = "Menyambung ke",
    [STR_CONNECTED] = "Terhubung!",
    [STR_CONNECTION_FAILED] = "Koneksi gagal",
    [STR_KB_SHIFT] = "Shift",
    [STR_KB_SPACE] = "Spasi",
    [STR_KB_GO] = "OK",
    [STR_VERSION] = "Versi:",
    [STR_FIRMWARE_URL] = "URL firmware:",
    [STR_READ] = "Dibaca:",
    [STR_UPDATE] = "Perbarui",
    [STR_RESTARTING] = "Mulai ulang",
    [STR_OTA_UPDATE] = "Pembaruan OTA",
    [STR_NTP_SERVER] = "Server NTP",
    [STR_NTP_SETTINGS] = "Pengaturan NTP",
    [STR_NTP_PRESETS] = "Preset NTP",
    [STR_PRESETS] = "Preset",
    [STR_BENCHMARK] = "Uji",
    [STR_STOPPING] = "Berhenti",
    [STR_NTP_STATS] = "Statistik NTP",
    [STR_UNSYNCED] = "tdk sync",
    [STR_SYNCS_LABEL] = "  Sync: ",
    [STR_AGE_LABEL] = "  Usia: ",
    [STR_NONE] = "tidak ada",
    [STR_SELECT_REGION] = "Pilih wilayah",
    [STR_STATUS] = "Status:",
    [STR_SERVER_LABEL] = "Server:",
    [STR_DST] = "DST",
    [STR_NO_DST] = "tanpa DST",
    [STR_FAIL] = "gagal",
};

static const char *const weekdays_id[7] = {
    "Min", "Sen", "Sel", "Rab", "Kam", "Jum", "Sab",
};

static const char *const months_id[12] = {
    "Jan", "Feb", "Mar", "Apr", "Mei", "Jun",
    "Jul", "Agu", "Sep", "Okt", "Nov", "Des",
};

static const char lang_name_id[] = "Indonesia";
