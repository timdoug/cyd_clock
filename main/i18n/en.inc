static const char *const lang_en[STR_COUNT] = {
    [STR_SETTINGS] = "Settings",
    [STR_WIFI] = "Wi-Fi",
    [STR_TIMEZONE] = "Time zone",
    [STR_BRIGHTNESS] = "Brightness",
    [STR_LED_BLINK] = "LED Blink",
    [STR_ROTATE] = "Rotate 180",
    [STR_ABOUT] = "About",
    [STR_LANGUAGE] = "Language",
    [STR_DONE] = "Done",
    [STR_BACK] = "Back",
    [STR_CANCEL] = "Cancel",
    [STR_DEL] = "Del",
    [STR_RUNNING] = "Running",
    [STR_ON] = "On",
    [STR_OFF] = "Off",
    [STR_WAITING_NTP] = "Waiting for NTP...",
    [STR_WIFI_SETUP] = "Wi-Fi Setup",
    [STR_SCANNING] = "Scanning...",
    [STR_SCAN_FAILED] = "Scan failed",
    [STR_TAP_RETRY] = "Tap to retry",
    [STR_SELECT_NETWORK] = "Select Network",
    [STR_NO_NETWORKS] = "No networks found",
    [STR_NETWORK_LABEL] = "Network:",
    [STR_ENTER_PASSWORD] = "Enter Password",
    [STR_CONNECTING] = "Connecting",
    [STR_CONNECTING_TO] = "Connecting to",
    [STR_CONNECTED] = "Connected!",
    [STR_CONNECTION_FAILED] = "Connection failed",
    [STR_KB_SHIFT] = "Shf",
    [STR_KB_SPACE] = "Space",
    [STR_KB_GO] = "Go",
    [STR_VERSION] = "Version:",
    [STR_FIRMWARE_URL] = "Firmware URL:",
    [STR_OTA_URL] = "OTA URL",
    [STR_STATUS] = "Status:",
    [STR_READ] = "Read:",
    [STR_UPDATE] = "Update",
    [STR_RESTARTING] = "Restarting",
    [STR_OTA_UPDATE] = "OTA Update",
    [STR_NTP_SERVER] = "NTP Server",
    [STR_SERVER_LABEL] = "Server:",
    [STR_NTP_SETTINGS] = "NTP Settings",
    [STR_NTP_PRESETS] = "NTP Presets",
    [STR_PRESETS] = "Presets",
    [STR_NONE] = "none",
    [STR_SELECT_REGION] = "Select Region",
    [STR_DST] = "DST",
    [STR_NO_DST] = "no DST",
};

static const char *const weekdays_en[7] = {
    "Sun", "Mon", "Tue", "Wed", "Thu", "Fri", "Sat",
};

static const char *const months_en[12] = {
    "Jan", "Feb", "Mar", "Apr", "May", "Jun",
    "Jul", "Aug", "Sep", "Oct", "Nov", "Dec",
};

static const char lang_name_en[] = "English";
