static const char *const lang_no[STR_COUNT] = {
    [STR_SETTINGS] = "Innstillinger",
    [STR_WIFI] = "Wi-Fi",
    [STR_FAIL] = "feil",
    [STR_TIMEZONE] = "Tidssone",
    [STR_BRIGHTNESS] = "Lysstyrke",
    [STR_LED_BLINK] = "LED-blink",
    [STR_ROTATE] = "Roter 180",
    [STR_ABOUT] = "Om",
    [STR_LANGUAGE] = "Språk",
    [STR_DONE] = "OK",
    [STR_BACK] = "Tilb.",
    [STR_CANCEL] = "Avbryt",
    [STR_DEL] = "Slett",
    [STR_RUNNING] = "Kjører",
    [STR_ON] = "På",
    [STR_OFF] = "Av",
    [STR_NTS_NO] = "Av",
    [STR_NTS_ATTEMPT] = "Prøv",
    [STR_NTS_REQUIRE] = "Krav",
    [STR_WAITING_NTP] = "Venter på NTP...",
    [STR_FMT_SYNCED] = "Synk.: %s",
    [STR_FMT_SYNCING] = "Synk...: %s",
    [STR_FMT_WAITING] = "Venter: %lus",
    [STR_FMT_PEERS_NOSYNC] = "%d/%d srv  poll %s  ikke synk",
    [STR_FMT_PEERS_AGO] = "%d/%d srv  poll %s  %s siden",
    [STR_WIFI_SETUP] = "Wi-Fi-opps.",
    [STR_SCANNING] = "Skanner...",
    [STR_SCAN_FAILED] = "Skann feilet",
    [STR_TAP_RETRY] = "Trykk for nytt",
    [STR_SELECT_NETWORK] = "Velg nettverk",
    [STR_NO_NETWORKS] = "Ingen nettverk",
    [STR_NETWORK_LABEL] = "Nett:",
    [STR_ENTER_PASSWORD] = "Passord",
    [STR_CONNECTING] = "Kobler til",
    [STR_CONNECTING_TO] = "Kobler til",
    [STR_CONNECTED] = "Tilkoblet!",
    [STR_CONNECTION_FAILED] = "Tilkobling feilet",
    [STR_KB_SHIFT] = "Skift",
    [STR_KB_SPACE] = "Mellomrom",
    [STR_KB_GO] = "OK",
    [STR_VERSION] = "Versjon:",
    [STR_FIRMWARE_URL] = "Firmware-URL:",
    [STR_OTA_URL] = "OTA-URL",
    [STR_STATUS] = "Status:",
    [STR_READ] = "Lest:",
    [STR_UPDATE] = "Oppdater",
    [STR_RESTARTING] = "Omstart",
    [STR_OTA_UPDATE] = "OTA-oppdat.",
    [STR_NTP_SERVER] = "NTP-server",
    [STR_SERVER_LABEL] = "Server:",
    [STR_NTP_SETTINGS] = "NTP-innst.",
    [STR_NTP_PRESETS] = "NTP-forh.",
    [STR_PRESETS] = "Forh.valg",
    [STR_BENCHMARK] = "Mål",
    [STR_STOPPING] = "Stopper",
    [STR_NTP_STATS] = "NTP-statistikk",
    [STR_UNSYNCED] = "ikke synk",
    [STR_SYNCS_LABEL] = "  Synk: ",
    [STR_AGE_LABEL] = "  Alder: ",
    [STR_NONE] = "ingen",
    [STR_SELECT_REGION] = "Velg region",
    [STR_DST] = "sommertid",
    [STR_NO_DST] = "uten sommertid",
};

static const char *const weekdays_no[7] = {
    "søn.", "man.", "tir.", "ons.", "tor.", "fre.", "lør.",
};

static const char *const months_no[12] = {
    "jan.", "feb.", "mars", "apr.", "mai", "juni",
    "juli", "aug.", "sep.", "okt.", "nov.", "des.",
};

static const char lang_name_no[] = "Norsk";
