static const char *const lang_de[STR_COUNT] = {
    [STR_SETTINGS] = "Einstellungen",
    [STR_WIFI] = "WLAN",
    [STR_FAIL] = "Fehler",
    [STR_TIMEZONE] = "Zeitzone",
    [STR_BRIGHTNESS] = "Helligkeit",
    [STR_LED_BLINK] = "LED-Blinken",
    [STR_ROTATE] = "Drehen 180",
    [STR_ABOUT] = "Info",
    [STR_LANGUAGE] = "Sprache",
    [STR_DONE] = "Fertig",
    [STR_BACK] = "Zurück",
    [STR_CANCEL] = "Abbr.",
    [STR_DEL] = "Entf",
    [STR_RUNNING] = "Läuft",
    [STR_ON] = "Ein",
    [STR_OFF] = "Aus",
    [STR_NTS_NO] = "Aus",
    [STR_NTS_ATTEMPT] = "Versuch",
    [STR_NTS_REQUIRE] = "Pflicht",
    [STR_WAITING_NTP] = "Warte auf NTP...",
    [STR_FMT_SYNCED] = "Sync.: %s",
    [STR_FMT_SYNCING] = "Sync...: %s",
    [STR_FMT_WAITING] = "Warte: %lus",
    [STR_FMT_PEERS_NOSYNC] = "%d/%d Server  poll %s  kein Sync",
    [STR_FMT_PEERS_AGO] = "%d/%d Server  poll %s  vor %s",
    [STR_WIFI_SETUP] = "WLAN-Setup",
    [STR_SCANNING] = "Suche...",
    [STR_SCAN_FAILED] = "Scan fehlg.",
    [STR_TAP_RETRY] = "Tippen zum Wiederh.",
    [STR_SELECT_NETWORK] = "Netz wählen",
    [STR_NO_NETWORKS] = "Keine Netze",
    [STR_NETWORK_LABEL] = "Netz:",
    [STR_ENTER_PASSWORD] = "Passwort",
    [STR_CONNECTING] = "Verbinde",
    [STR_CONNECTING_TO] = "Verbinde mit",
    [STR_CONNECTED] = "Verbunden!",
    [STR_CONNECTION_FAILED] = "Verbindung fehlg.",
    [STR_KB_SHIFT] = "Umsch",
    [STR_KB_SPACE] = "Leer",
    [STR_KB_GO] = "Los",
    [STR_VERSION] = "Version:",
    [STR_FIRMWARE_URL] = "Firmware-URL:",
    [STR_OTA_URL] = "OTA-URL",
    [STR_STATUS] = "Status:",
    [STR_READ] = "Gelesen:",
    [STR_UPDATE] = "Aktualis.",
    [STR_RESTARTING] = "Neustart",
    [STR_OTA_UPDATE] = "OTA-Update",
    [STR_NTP_SERVER] = "NTP-Server",
    [STR_SERVER_LABEL] = "Server:",
    [STR_NTP_SETTINGS] = "NTP-Einstell.",
    [STR_NTP_PRESETS] = "NTP-Vorgaben",
    [STR_PRESETS] = "Vorgaben",
    [STR_BENCHMARK] = "Messen",
    [STR_STOPPING] = "Stoppt",
    [STR_NTP_STATS] = "NTP-Statistik",
    [STR_UNSYNCED] = "kein Sync",
    [STR_SYNCS_LABEL] = "  Sync: ",
    [STR_AGE_LABEL] = "  Alter: ",
    [STR_NONE] = "keine",
    [STR_SELECT_REGION] = "Region wählen",
    [STR_DST] = "Sommerzeit",
    [STR_NO_DST] = "ohne Sommerzeit",
};

static const char *const weekdays_de[7] = {
    "So", "Mo", "Di", "Mi", "Do", "Fr", "Sa",
};

static const char *const months_de[12] = {
    "Jan", "Feb", "Mär", "Apr", "Mai", "Jun",
    "Jul", "Aug", "Sep", "Okt", "Nov", "Dez",
};

static const char lang_name_de[] = "Deutsch";
