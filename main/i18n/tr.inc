static const char *const lang_tr[STR_COUNT] = {
    [STR_SETTINGS] = "Ayarlar",
    [STR_WIFI] = "Wi-Fi",
    [STR_FAIL] = "hata",
    [STR_TIMEZONE] = "Saat dilimi",
    [STR_BRIGHTNESS] = "Parlaklık",
    [STR_LED_BLINK] = "LED Yan.Sön",
    [STR_ROTATE] = "Döndür 180",
    [STR_ABOUT] = "Hakkında",
    [STR_LANGUAGE] = "Dil",
    [STR_DONE] = "Tamam",
    [STR_BACK] = "Geri",
    [STR_CANCEL] = "Vazgeç",
    [STR_DEL] = "Sil",
    [STR_RUNNING] = "Devam",
    [STR_ON] = "Açık",
    [STR_OFF] = "Kapalı",
    [STR_NTS_NO] = "Kapalı",
    [STR_NTS_ATTEMPT] = "Dene",
    [STR_NTS_REQUIRE] = "Zorunlu",
    [STR_WAITING_NTP] = "NTP bekleniyor...",
    [STR_FMT_SYNCED] = "Sync.: %s",
    [STR_FMT_SYNCING] = "Sync...: %s",
    [STR_FMT_WAITING] = "Bekle: %lus",
    [STR_FMT_PEERS_NOSYNC] = "%d/%d srv  poll %s  sync yok",
    [STR_FMT_PEERS_AGO] = "%d/%d srv  poll %s  %s önce",
    [STR_WIFI_SETUP] = "Wi-Fi Kur.",
    [STR_SCANNING] = "Taranıyor...",
    [STR_SCAN_FAILED] = "Tarama hatası",
    [STR_TAP_RETRY] = "Tekrar dokun",
    [STR_SELECT_NETWORK] = "Ağ seç",
    [STR_NO_NETWORKS] = "Ağ yok",
    [STR_NETWORK_LABEL] = "Ağ:",
    [STR_ENTER_PASSWORD] = "Parola",
    [STR_CONNECTING] = "Bağlanıyor",
    [STR_CONNECTING_TO] = "Bağlanıyor",
    [STR_CONNECTED] = "Bağlandı!",
    [STR_CONNECTION_FAILED] = "Bağlantı hatası",
    [STR_KB_SHIFT] = "Shift",
    [STR_KB_SPACE] = "Boşluk",
    [STR_KB_GO] = "Git",
    [STR_VERSION] = "Sürüm:",
    [STR_FIRMWARE_URL] = "URL firmware:",
    [STR_OTA_URL] = "OTA URL",
    [STR_STATUS] = "Durum:",
    [STR_READ] = "Okunan:",
    [STR_UPDATE] = "Güncelle",
    [STR_RESTARTING] = "Başlatılıyor",
    [STR_OTA_UPDATE] = "OTA Günc.",
    [STR_NTP_SERVER] = "NTP Sunucu",
    [STR_SERVER_LABEL] = "Sunucu:",
    [STR_NTP_SETTINGS] = "NTP Ayar.",
    [STR_NTP_PRESETS] = "NTP Profil.",
    [STR_PRESETS] = "Profiller",
    [STR_BENCHMARK] = "Test",
    [STR_STOPPING] = "Durdur.",
    [STR_NTP_STATS] = "NTP İstat.",
    [STR_UNSYNCED] = "sync yok",
    [STR_SYNCS_LABEL] = "  Sync: ",
    [STR_AGE_LABEL] = "  Yaş: ",
    [STR_NONE] = "yok",
    [STR_SELECT_REGION] = "Bölge seç",
    [STR_DST] = "yaz saati",
    [STR_NO_DST] = "yaz saati yok",
};

static const char *const weekdays_tr[7] = {
    "Paz", "Pzt", "Sal", "Çar", "Per", "Cum", "Cmt",
};

static const char *const months_tr[12] = {
    "Oca", "Şub", "Mar", "Nis", "May", "Haz",
    "Tem", "Ağu", "Eyl", "Eki", "Kas", "Ara",
};

static const char lang_name_tr[] = "Türkçe";
