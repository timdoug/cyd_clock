static const char *const lang_el[STR_COUNT] = {
    [STR_SETTINGS] = "Ρυθμίσεις",
    [STR_WIFI] = "Wi-Fi",
    [STR_TIMEZONE] = "Ζώνη ώρας",
    [STR_BRIGHTNESS] = "Φωτεινότητα",
    [STR_LED_BLINK] = "LED αναβ.",
    [STR_ROTATE] = "Στροφή 180",
    [STR_ABOUT] = "Σχετικά",
    [STR_LANGUAGE] = "Γλώσσα",
    [STR_DONE] = "Τέλος",
    [STR_BACK] = "Πίσω",
    [STR_CANCEL] = "Άκυρο",
    [STR_DEL] = "Διαγρ.",
    [STR_RUNNING] = "Εκτέλεση",
    [STR_ON] = "Ενεργό",
    [STR_OFF] = "Ανενεργό",
    [STR_NTS_NO] = "Όχι",
    [STR_NTS_ATTEMPT] = "Δοκιμή",
    [STR_NTS_REQUIRE] = "Απαίτηση",
    [STR_WAITING_NTP] = "Αναμονή NTP...",
    [STR_FMT_SYNCED] = "Συγχρ.: %s",
    [STR_FMT_SYNCING] = "Συγχρονισμός: %s",
    [STR_FMT_WAITING] = "Αναμονή: %lus",
    [STR_FMT_PEERS_NOSYNC] = "%d/%d διακομ.  poll %s  χωρίς συγχρ.",
    [STR_FMT_PEERS_AGO] = "%d/%d διακομ.  poll %s  πριν %s",
    [STR_FMT_OFF_DRIFT] = "απόκλ. %s %s ολίσθ. %s",
    [STR_WIFI_SETUP] = "Ρύθμιση Wi-Fi",
    [STR_SCANNING] = "Σάρωση...",
    [STR_SCAN_FAILED] = "Αποτυχία σάρωσης",
    [STR_TAP_RETRY] = "Πατήστε ξανά",
    [STR_SELECT_NETWORK] = "Επιλογή δικτύου",
    [STR_NO_NETWORKS] = "Δεν βρέθηκαν δίκτυα",
    [STR_NETWORK_LABEL] = "Δίκτυο:",
    [STR_ENTER_PASSWORD] = "Κωδικός",
    [STR_CONNECTING] = "Σύνδεση",
    [STR_CONNECTING_TO] = "Σύνδεση σε",
    [STR_CONNECTED] = "Συνδέθηκε!",
    [STR_CONNECTION_FAILED] = "Αποτυχία σύνδεσης",
    [STR_KB_SHIFT] = "Shift",
    [STR_KB_SPACE] = "Κενό",
    [STR_KB_GO] = "OK",
    [STR_VERSION] = "Έκδοση:",
    [STR_FIRMWARE_URL] = "URL firmware:",
    [STR_OTA_URL] = "OTA URL",
    [STR_STATUS] = "Κατάσταση:",
    [STR_READ] = "Ανάγν.:",
    [STR_UPDATE] = "Ενημέρ.",
    [STR_RESTARTING] = "Επανεκκίνηση",
    [STR_OTA_UPDATE] = "OTA ενημέρωση",
    [STR_NTP_SERVER] = "Διακομιστής NTP",
    [STR_SERVER_LABEL] = "Διακομιστής:",
    [STR_NTP_SETTINGS] = "Ρυθμίσεις NTP",
    [STR_NTP_PRESETS] = "Προφίλ NTP",
    [STR_PRESETS] = "Προφίλ",
    [STR_BENCHMARK] = "Δοκιμή",
    [STR_STOPPING] = "Διακοπή",
    [STR_FAIL] = "αποτυχία",
    [STR_NTP_STATS] = "Στατιστικά NTP",
    [STR_UNSYNCED] = "ασύγχρ.",
    [STR_SYNCS_LABEL] = " Συγχρ.: ",
    [STR_AGE_LABEL] = "  Ηλικία: ",
    [STR_NONE] = "κανένα",
    [STR_SELECT_REGION] = "Επιλογή περιοχής",
    [STR_DST] = "θερινή ώρα",
    [STR_NO_DST] = "χωρίς θερ. ώρα",
};

static const char *const weekdays_el[7] = {
    "Κυρ", "Δευ", "Τρί", "Τετ", "Πέμ", "Παρ", "Σάβ",
};

static const char *const months_el[12] = {
    "Ιαν", "Φεβ", "Μαρ", "Απρ", "Μαΐ", "Ιουν",
    "Ιουλ", "Αυγ", "Σεπ", "Οκτ", "Νοε", "Δεκ",
};

static const char lang_name_el[] = "Ελληνικά";
