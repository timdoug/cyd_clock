static const char *const lang_da[STR_COUNT] = {
    [STR_SETTINGS] = "Indstillinger",
    [STR_WIFI] = "Wi-Fi",
    [STR_TIMEZONE] = "Tidszone",
    [STR_BRIGHTNESS] = "Lysstyrke",
    [STR_LED_BLINK] = "LED-blink",
    [STR_ROTATE] = "Roter 180",
    [STR_ABOUT] = "Om",
    [STR_LANGUAGE] = "Sprog",
    [STR_DONE] = "OK",
    [STR_BACK] = "Tilb.",
    [STR_CANCEL] = "Annul.",
    [STR_DEL] = "Slet",
    [STR_RUNNING] = "Kører",
    [STR_ON] = "Til",
    [STR_OFF] = "Fra",
    [STR_WAITING_NTP] = "Venter på NTP...",
    [STR_WIFI_SETUP] = "Wi-Fi-ops.",
    [STR_SCANNING] = "Scanner...",
    [STR_SCAN_FAILED] = "Scanning fejlede",
    [STR_TAP_RETRY] = "Tryk for at prøve",
    [STR_SELECT_NETWORK] = "Vælg netværk",
    [STR_NO_NETWORKS] = "Ingen netværk",
    [STR_NETWORK_LABEL] = "Netværk:",
    [STR_ENTER_PASSWORD] = "Adgangskode",
    [STR_CONNECTING] = "Forbinder",
    [STR_CONNECTING_TO] = "Forbinder til",
    [STR_CONNECTED] = "Forbundet!",
    [STR_CONNECTION_FAILED] = "Forbindelse fejlede",
    [STR_KB_SHIFT] = "Skift",
    [STR_KB_SPACE] = "Mellemrum",
    [STR_KB_GO] = "OK",
    [STR_VERSION] = "Version:",
    [STR_FIRMWARE_URL] = "Firmware-URL:",
    [STR_OTA_URL] = "OTA-URL",
    [STR_STATUS] = "Status:",
    [STR_READ] = "Læst:",
    [STR_UPDATE] = "Opdater",
    [STR_RESTARTING] = "Genstarter",
    [STR_OTA_UPDATE] = "OTA-opdat.",
    [STR_NTP_SERVER] = "NTP-server",
    [STR_SERVER_LABEL] = "Server:",
    [STR_NTP_SETTINGS] = "NTP-indst.",
    [STR_NTP_PRESETS] = "NTP-forindst.",
    [STR_PRESETS] = "Forindst.",
    [STR_NONE] = "ingen",
    [STR_SELECT_REGION] = "Vælg region",
    [STR_DST] = "sommertid",
    [STR_NO_DST] = "ingen sommertid",
};

static const char *const weekdays_da[7] = {
    "søn.", "man.", "tirs.", "ons.", "tors.", "fre.", "lør.",
};

static const char *const months_da[12] = {
    "jan.", "feb.", "mar.", "apr.", "maj", "jun.",
    "jul.", "aug.", "sep.", "okt.", "nov.", "dec.",
};

static const char lang_name_da[] = "Dansk";
