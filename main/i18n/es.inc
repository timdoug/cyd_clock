static const char *const lang_es[STR_COUNT] = {
    [STR_SETTINGS] = "Ajustes",
    [STR_WIFI] = "Wi-Fi",
    [STR_FAIL] = "fallo",
    [STR_TIMEZONE] = "Zona horaria",
    [STR_BRIGHTNESS] = "Brillo",
    [STR_LED_BLINK] = "LED Parpad.",
    [STR_ROTATE] = "Girar 180",
    [STR_ABOUT] = "Acerca de",
    [STR_LANGUAGE] = "Idioma",
    [STR_DONE] = "Listo",
    [STR_BACK] = "Atrás",
    [STR_CANCEL] = "Canc.",
    [STR_DEL] = "Supr",
    [STR_RUNNING] = "Ejecut.",
    [STR_ON] = "Sí",
    [STR_OFF] = "No",
    [STR_NTS_NO] = "No",
    [STR_NTS_ATTEMPT] = "Intentar",
    [STR_NTS_REQUIRE] = "Requerir",
    [STR_WAITING_NTP] = "Esperando NTP...",
    [STR_FMT_SYNCED] = "Sinc.: %s",
    [STR_FMT_SYNCING] = "Sinc...: %s",
    [STR_FMT_WAITING] = "Espera: %lus",
    [STR_FMT_PEERS_NOSYNC] = "%d/%d serv  poll %s  sin sinc",
    [STR_FMT_PEERS_AGO] = "%d/%d serv  poll %s  hace %s",
    [STR_WIFI_SETUP] = "Config. Wi-Fi",
    [STR_SCANNING] = "Buscando...",
    [STR_SCAN_FAILED] = "Fallo al buscar",
    [STR_TAP_RETRY] = "Toca para reintentar",
    [STR_SELECT_NETWORK] = "Elige red",
    [STR_NO_NETWORKS] = "Sin redes",
    [STR_NETWORK_LABEL] = "Red:",
    [STR_ENTER_PASSWORD] = "Contraseña",
    [STR_CONNECTING] = "Conectando",
    [STR_CONNECTING_TO] = "Conectando a",
    [STR_CONNECTED] = "¡Conectado!",
    [STR_CONNECTION_FAILED] = "Fallo de conexión",
    [STR_KB_SHIFT] = "May",
    [STR_KB_SPACE] = "Espacio",
    [STR_KB_GO] = "Ir",
    [STR_VERSION] = "Versión:",
    [STR_FIRMWARE_URL] = "URL firmware:",
    [STR_OTA_URL] = "URL OTA",
    [STR_STATUS] = "Estado:",
    [STR_READ] = "Leído:",
    [STR_UPDATE] = "Actualizar",
    [STR_RESTARTING] = "Reiniciando",
    [STR_OTA_UPDATE] = "Actualiz. OTA",
    [STR_NTP_SERVER] = "Servidor NTP",
    [STR_SERVER_LABEL] = "Servidor:",
    [STR_NTP_SETTINGS] = "Ajustes NTP",
    [STR_NTP_PRESETS] = "Predef. NTP",
    [STR_PRESETS] = "Predefinidos",
    [STR_BENCHMARK] = "Medir",
    [STR_STOPPING] = "Parando",
    [STR_NTP_STATS] = "Estad. NTP",
    [STR_UNSYNCED] = "sin sinc",
    [STR_SYNCS_LABEL] = "  Sinc.: ",
    [STR_AGE_LABEL] = "  Edad: ",
    [STR_NONE] = "ninguna",
    [STR_SELECT_REGION] = "Elige región",
    [STR_DST] = "hora de verano",
    [STR_NO_DST] = "sin h. verano",
};

static const char *const weekdays_es[7] = {
    "dom", "lun", "mar", "mié", "jue", "vie", "sáb",
};

static const char *const months_es[12] = {
    "ene", "feb", "mar", "abr", "may", "jun",
    "jul", "ago", "sept", "oct", "nov", "dic",
};

static const char lang_name_es[] = "Español";
