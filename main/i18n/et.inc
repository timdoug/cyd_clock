static const char *const lang_et[STR_COUNT] = {
    [STR_SETTINGS] = "Seaded",
    [STR_WIFI] = "Wi-Fi",
    [STR_TIMEZONE] = "Ajavöönd",
    [STR_BRIGHTNESS] = "Heledus",
    [STR_LED_BLINK] = "LED vilgub",
    [STR_ROTATE] = "Pööra 180",
    [STR_ABOUT] = "Teave",
    [STR_LANGUAGE] = "Keel",
    [STR_DONE] = "Valmis",
    [STR_BACK] = "Tagasi",
    [STR_CANCEL] = "Tühista",
    [STR_DEL] = "Kustuta",
    [STR_RUNNING] = "Töötab",
    [STR_ON] = "Sees",
    [STR_OFF] = "Väljas",
    [STR_NTS_NO] = "Ei",
    [STR_NTS_ATTEMPT] = "Proovi",
    [STR_NTS_REQUIRE] = "Nõua",
    [STR_WAITING_NTP] = "NTP ootamine...",
    [STR_FMT_SYNCED] = "Sünk.: %s",
    [STR_FMT_SYNCING] = "Sünkroonib: %s",
    [STR_FMT_WAITING] = "Ootamine: %lus",
    [STR_FMT_PEERS_NOSYNC] = "%d/%d serv.  poll %s  sync puudub",
    [STR_FMT_PEERS_AGO] = "%d/%d serv.  poll %s  %s tagasi",
    [STR_FMT_OFF_DRIFT] = "nihe %s %s drift %s",
    [STR_WIFI_SETUP] = "Wi-Fi seaded",
    [STR_SCANNING] = "Skannimine...",
    [STR_SCAN_FAILED] = "Skannimine nurjus",
    [STR_TAP_RETRY] = "Puuduta uuesti",
    [STR_SELECT_NETWORK] = "Vali võrk",
    [STR_NO_NETWORKS] = "Võrke ei leitud",
    [STR_NETWORK_LABEL] = "Võrk:",
    [STR_ENTER_PASSWORD] = "Sisesta parool",
    [STR_CONNECTING] = "Ühendamine",
    [STR_CONNECTING_TO] = "Ühendumine",
    [STR_CONNECTED] = "Ühendatud!",
    [STR_CONNECTION_FAILED] = "Ühendus nurjus",
    [STR_KB_SHIFT] = "Shift",
    [STR_KB_SPACE] = "Tühik",
    [STR_KB_GO] = "OK",
    [STR_VERSION] = "Versioon:",
    [STR_FIRMWARE_URL] = "Firmware URL:",
    [STR_OTA_URL] = "OTA URL",
    [STR_STATUS] = "Olek:",
    [STR_READ] = "Loetud:",
    [STR_UPDATE] = "Uuenda",
    [STR_RESTARTING] = "Taaskäivitus",
    [STR_OTA_UPDATE] = "OTA uuendus",
    [STR_NTP_SERVER] = "NTP server",
    [STR_SERVER_LABEL] = "Server:",
    [STR_NTP_SETTINGS] = "NTP seaded",
    [STR_NTP_PRESETS] = "NTP profiilid",
    [STR_PRESETS] = "Profiilid",
    [STR_BENCHMARK] = "Test",
    [STR_STOPPING] = "Peatamine",
    [STR_FAIL] = "viga",
    [STR_NTP_STATS] = "NTP statistika",
    [STR_UNSYNCED] = "puudub",
    [STR_SYNCS_LABEL] = "  Sync.: ",
    [STR_AGE_LABEL] = "  Vanus: ",
    [STR_NONE] = "puudub",
    [STR_SELECT_REGION] = "Vali piirkond",
    [STR_DST] = "suveaeg",
    [STR_NO_DST] = "suveaega pole",
};

static const char *const weekdays_et[7] = {
    "P", "E", "T", "K", "N", "R", "L",
};

static const char *const months_et[12] = {
    "jaan", "veebr", "märts", "apr", "mai", "juuni",
    "juuli", "aug", "sept", "okt", "nov", "dets",
};

static const char lang_name_et[] = "Eesti";
