static const char *const lang_fi[STR_COUNT] = {
    [STR_SETTINGS] = "Asetukset",
    [STR_WIFI] = "Wi-Fi",
    [STR_TIMEZONE] = "Aikavyöhyke",
    [STR_BRIGHTNESS] = "Kirkkaus",
    [STR_LED_BLINK] = "LED-vilkku",
    [STR_ROTATE] = "Kierrä 180",
    [STR_ABOUT] = "Tietoja",
    [STR_LANGUAGE] = "Kieli",
    [STR_DONE] = "Valmis",
    [STR_BACK] = "Paluu",
    [STR_CANCEL] = "Peru",
    [STR_DEL] = "Pyyhi",
    [STR_RUNNING] = "Käynnissä",
    [STR_ON] = "On",
    [STR_OFF] = "Pois",
    [STR_WAITING_NTP] = "Odotetaan NTP:tä...",
    [STR_WIFI_SETUP] = "Wi-Fi-asetus",
    [STR_SCANNING] = "Haetaan...",
    [STR_SCAN_FAILED] = "Haku epäonnistui",
    [STR_TAP_RETRY] = "Napauta uudelleen",
    [STR_SELECT_NETWORK] = "Valitse verkko",
    [STR_NO_NETWORKS] = "Ei verkkoja",
    [STR_NETWORK_LABEL] = "Verkko:",
    [STR_ENTER_PASSWORD] = "Salasana",
    [STR_CONNECTING] = "Yhdistetään",
    [STR_CONNECTING_TO] = "Yhdistetään",
    [STR_CONNECTED] = "Yhdistetty!",
    [STR_CONNECTION_FAILED] = "Yhteys epäonnistui",
    [STR_KB_SHIFT] = "Vaiht",
    [STR_KB_SPACE] = "Väli",
    [STR_KB_GO] = "OK",
    [STR_VERSION] = "Versio:",
    [STR_FIRMWARE_URL] = "Firmware-URL:",
    [STR_OTA_URL] = "OTA-URL",
    [STR_STATUS] = "Tila:",
    [STR_READ] = "Luettu:",
    [STR_UPDATE] = "Päivitä",
    [STR_RESTARTING] = "Käynnistyy",
    [STR_OTA_UPDATE] = "OTA-päivitys",
    [STR_NTP_SERVER] = "NTP-palvelin",
    [STR_SERVER_LABEL] = "Palvelin:",
    [STR_NTP_SETTINGS] = "NTP-asetukset",
    [STR_NTP_PRESETS] = "NTP-esival.",
    [STR_PRESETS] = "Esivalinnat",
    [STR_NONE] = "ei mitään",
    [STR_SELECT_REGION] = "Valitse alue",
    [STR_DST] = "kesäaika",
    [STR_NO_DST] = "ei kesäaikaa",
};

static const char *const weekdays_fi[7] = {
    "su", "ma", "ti", "ke", "to", "pe", "la",
};

static const char *const months_fi[12] = {
    "tammik.", "helmik.", "maalisk.", "huhtik.", "toukok.", "kesäk.",
    "heinäk.", "elok.", "syysk.", "lokak.", "marrask.", "jouluk.",
};

static const char lang_name_fi[] = "Suomi";
