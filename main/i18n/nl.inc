static const char *const lang_nl[STR_COUNT] = {
    [STR_SETTINGS] = "Instellingen",
    [STR_WIFI] = "Wifi",
    [STR_FAIL] = "fout",
    [STR_TIMEZONE] = "Tijdzone",
    [STR_BRIGHTNESS] = "Helderheid",
    [STR_LED_BLINK] = "LED-knip.",
    [STR_ROTATE] = "Draai 180",
    [STR_ABOUT] = "Info",
    [STR_LANGUAGE] = "Taal",
    [STR_DONE] = "OK",
    [STR_BACK] = "Terug",
    [STR_CANCEL] = "Annul.",
    [STR_DEL] = "Wis",
    [STR_RUNNING] = "Bezig",
    [STR_ON] = "Aan",
    [STR_OFF] = "Uit",
    [STR_NTS_NO] = "Uit",
    [STR_NTS_ATTEMPT] = "Probeer",
    [STR_NTS_REQUIRE] = "Vereis",
    [STR_WAITING_NTP] = "Wachten op NTP...",
    [STR_FMT_SYNCED] = "Sync.: %s",
    [STR_FMT_SYNCING] = "Bezig: %s",
    [STR_FMT_WAITING] = "Wachten: %lus",
    [STR_FMT_PEERS_NOSYNC] = "%d/%d srv  poll %s  geen sync",
    [STR_FMT_PEERS_AGO] = "%d/%d srv  poll %s  %s geleden",
    [STR_WIFI_SETUP] = "Wifi instellen",
    [STR_SCANNING] = "Scannen...",
    [STR_SCAN_FAILED] = "Scan mislukt",
    [STR_TAP_RETRY] = "Tik opnieuw",
    [STR_SELECT_NETWORK] = "Kies netwerk",
    [STR_NO_NETWORKS] = "Geen netwerken",
    [STR_NETWORK_LABEL] = "Netwerk:",
    [STR_ENTER_PASSWORD] = "Wachtwoord",
    [STR_CONNECTING] = "Verbinden",
    [STR_CONNECTING_TO] = "Verbinden met",
    [STR_CONNECTED] = "Verbonden!",
    [STR_CONNECTION_FAILED] = "Verbinding mislukt",
    [STR_KB_SHIFT] = "Shift",
    [STR_KB_SPACE] = "Spatie",
    [STR_KB_GO] = "Ga",
    [STR_VERSION] = "Versie:",
    [STR_FIRMWARE_URL] = "Firmware-URL:",
    [STR_OTA_URL] = "OTA-URL",
    [STR_STATUS] = "Status:",
    [STR_READ] = "Gelezen:",
    [STR_UPDATE] = "Bijwerken",
    [STR_RESTARTING] = "Herstarten",
    [STR_OTA_UPDATE] = "OTA-update",
    [STR_NTP_SERVER] = "NTP-server",
    [STR_SERVER_LABEL] = "Server:",
    [STR_NTP_SETTINGS] = "NTP-instell.",
    [STR_NTP_PRESETS] = "NTP-presets",
    [STR_PRESETS] = "Presets",
    [STR_BENCHMARK] = "Meten",
    [STR_STOPPING] = "Stoppen",
    [STR_NTP_STATS] = "NTP-statistiek",
    [STR_UNSYNCED] = "geen sync",
    [STR_AGE_LABEL] = "  Leeftijd: ",
    [STR_NONE] = "geen",
    [STR_SELECT_REGION] = "Kies regio",
    [STR_SYNCS_LABEL] = "  Sync: ",
    [STR_DST] = "zomertijd",
    [STR_NO_DST] = "geen zomertijd",
};

static const char *const weekdays_nl[7] = {
    "zo", "ma", "di", "wo", "do", "vr", "za",
};

static const char *const months_nl[12] = {
    "jan", "feb", "mrt", "apr", "mei", "jun",
    "jul", "aug", "sep", "okt", "nov", "dec",
};

static const char lang_name_nl[] = "Nederlands";
