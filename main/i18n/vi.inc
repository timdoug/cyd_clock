static const char *const lang_vi[STR_COUNT] = {
    [STR_SETTINGS] = "Cài đặt",
    [STR_WIFI] = "Wi-Fi",
    [STR_TIMEZONE] = "Múi giờ",
    [STR_BRIGHTNESS] = "Độ sáng",
    [STR_LED_BLINK] = "LED nháy",
    [STR_ROTATE] = "Xoay 180",
    [STR_ABOUT] = "Giới thiệu",
    [STR_LANGUAGE] = "Ngôn ngữ",
    [STR_DONE] = "Xong",
    [STR_BACK] = "Quay lại",
    [STR_CANCEL] = "Hủy",
    [STR_DEL] = "Xóa",
    [STR_RUNNING] = "Đang chạy",
    [STR_ON] = "Bật",
    [STR_OFF] = "Tắt",
    [STR_NTS_NO] = "Không",
    [STR_NTS_ATTEMPT] = "Thử",
    [STR_NTS_REQUIRE] = "Bắt buộc",
    [STR_WAITING_NTP] = "Đang chờ NTP...",
    [STR_FMT_SYNCED] = "Đã đồng bộ: %s",
    [STR_FMT_SYNCING] = "Đang đồng bộ: %s",
    [STR_FMT_WAITING] = "Đang chờ: %lus",
    [STR_FMT_PEERS_NOSYNC] = "%d/%d nguồn  poll %s  chưa đồng bộ",
    [STR_FMT_PEERS_AGO] = "%d/%d nguồn  poll %s  %s trước",
    [STR_FMT_OFF_DRIFT] = "lệch %s %s trôi %s",
    [STR_WIFI_SETUP] = "Cài đặt Wi-Fi",
    [STR_SCANNING] = "Đang quét...",
    [STR_SCAN_FAILED] = "Quét thất bại",
    [STR_TAP_RETRY] = "Chạm để thử lại",
    [STR_SELECT_NETWORK] = "Chọn mạng",
    [STR_NO_NETWORKS] = "Không tìm thấy mạng",
    [STR_NETWORK_LABEL] = "Mạng:",
    [STR_ENTER_PASSWORD] = "Nhập mật khẩu",
    [STR_CONNECTING] = "Đang kết nối",
    [STR_CONNECTING_TO] = "Kết nối tới",
    [STR_CONNECTED] = "Đã kết nối!",
    [STR_CONNECTION_FAILED] = "Kết nối thất bại",
    [STR_KB_SHIFT] = "Shift",
    [STR_KB_SPACE] = "Dấu cách",
    [STR_KB_GO] = "OK",
    [STR_VERSION] = "Phiên bản:",
    [STR_FIRMWARE_URL] = "URL firmware:",
    [STR_OTA_URL] = "OTA URL",
    [STR_STATUS] = "Trạng thái:",
    [STR_READ] = "Đã đọc:",
    [STR_UPDATE] = "Cập nhật",
    [STR_RESTARTING] = "Đang khởi động lại",
    [STR_OTA_UPDATE] = "Cập nhật OTA",
    [STR_NTP_SERVER] = "Máy chủ NTP",
    [STR_SERVER_LABEL] = "Máy chủ:",
    [STR_NTP_SETTINGS] = "Cài đặt NTP",
    [STR_NTP_PRESETS] = "Mẫu NTP",
    [STR_PRESETS] = "Mẫu",
    [STR_BENCHMARK] = "Kiểm tra",
    [STR_STOPPING] = "Đang dừng",
    [STR_FAIL] = "lỗi",
    [STR_NTP_STATS] = "Thống kê NTP",
    [STR_UNSYNCED] = "chưa ĐB",
    [STR_STRATUM_LABEL] = "Tầng: ",
    [STR_SYNCS_LABEL] = "  Lần: ",
    [STR_DRIFT_LABEL] = "Trôi: ",
    [STR_AGE_LABEL] = "  Tuổi: ",
    [STR_OFFSET_LABEL] = "Lệch: ",
    [STR_ROOT_LABEL] = "Gốc: ",
    [STR_FMT_ROOT_DETAIL] = "%s trễ, %s phân tán",
    [STR_NONE] = "không có",
    [STR_SELECT_REGION] = "Chọn khu vực",
    [STR_DST] = "giờ mùa hè",
    [STR_NO_DST] = "không giờ hè",
};

static const char *const weekdays_vi[7] = {
    "CN", "T2", "T3", "T4", "T5", "T6", "T7",
};

static const char *const months_vi[12] = {
    "thg 1", "thg 2", "thg 3", "thg 4", "thg 5", "thg 6",
    "thg 7", "thg 8", "thg 9", "thg 10", "thg 11", "thg 12",
};

static const char lang_name_vi[] = "Tiếng Việt";
