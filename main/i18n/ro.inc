static const char *const lang_ro[STR_COUNT] = {
    [STR_SETTINGS] = "Setări",
    [STR_WIFI] = "Wi-Fi",
    [STR_TIMEZONE] = "Fus orar",
    [STR_BRIGHTNESS] = "Luminoz.",
    [STR_LED_BLINK] = "LED Clipire",
    [STR_ROTATE] = "Rotire 180",
    [STR_ABOUT] = "Despre",
    [STR_LANGUAGE] = "Limbă",
    [STR_DONE] = "Gata",
    [STR_BACK] = "Înapoi",
    [STR_CANCEL] = "Anul.",
    [STR_DEL] = "Șterg",  // "Sterg." (6 ch) overflows the 5-ch kb Del key
    [STR_RUNNING] = "Rulează",
    [STR_ON] = "Pornit",
    [STR_OFF] = "Oprit",
    [STR_WAITING_NTP] = "Așteptare NTP...",
    [STR_WIFI_SETUP] = "Config. Wi-Fi",
    [STR_SCANNING] = "Scanare...",
    [STR_SCAN_FAILED] = "Scanare eșuată",
    [STR_TAP_RETRY] = "Atinge pt. reluare",
    [STR_SELECT_NETWORK] = "Alege rețeaua",
    [STR_NO_NETWORKS] = "Nicio rețea",
    [STR_NETWORK_LABEL] = "Rețea:",
    [STR_ENTER_PASSWORD] = "Parolă",
    [STR_CONNECTING] = "Conectare",
    [STR_CONNECTING_TO] = "Conectare la",
    [STR_CONNECTED] = "Conectat!",
    [STR_CONNECTION_FAILED] = "Conectare eșuată",
    [STR_KB_SHIFT] = "Shift",
    [STR_KB_SPACE] = "Spațiu",
    [STR_KB_GO] = "OK",
    [STR_VERSION] = "Vers.:",  // "Versiune:" (9 ch) collides with the value column at 8
    [STR_FIRMWARE_URL] = "URL firmware:",
    [STR_STATUS] = "Stare:",
    [STR_READ] = "Citit:",
    [STR_UPDATE] = "Actualiz.",
    [STR_RESTARTING] = "Repornire",
    [STR_OTA_UPDATE] = "Actualiz. OTA",
    [STR_NTP_SERVER] = "Server NTP",
    [STR_NTP_SETTINGS] = "Setări NTP",
    [STR_NTP_PRESETS] = "Profile NTP",
    [STR_PRESETS] = "Profile",
    [STR_NONE] = "niciuna",
    [STR_SELECT_REGION] = "Alege regiunea",
    [STR_SERVER_LABEL] = "Server:",
    [STR_DST] = "ora de vară",
    [STR_NO_DST] = "fără o. de vară",
};

static const char *const weekdays_ro[7] = {
    "dum.", "lun.", "mar.", "mie.", "joi", "vin.", "sâm.",
};

static const char *const months_ro[12] = {
    "ian.", "feb.", "mar.", "apr.", "mai", "iun.",
    "iul.", "aug.", "sept.", "oct.", "nov.", "dec.",
};

static const char lang_name_ro[] = "Română";
