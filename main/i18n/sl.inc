static const char *const lang_sl[STR_COUNT] = {
    [STR_SETTINGS] = "Nastavitve",
    [STR_WIFI] = "Wi-Fi",
    [STR_TIMEZONE] = "Časovni pas",
    [STR_BRIGHTNESS] = "Svetlost",
    [STR_LED_BLINK] = "Utrip LED",
    [STR_ROTATE] = "Zasuk 180",
    [STR_ABOUT] = "O napravi",
    [STR_LANGUAGE] = "Jezik",
    [STR_DONE] = "Končano",
    [STR_BACK] = "Nazaj",
    [STR_CANCEL] = "Prekliči",
    [STR_DEL] = "Izbriši",
    [STR_RUNNING] = "Teče",
    [STR_ON] = "Vklop",
    [STR_OFF] = "Izklop",
    [STR_NTS_NO] = "Ne",
    [STR_NTS_ATTEMPT] = "Poskusi",
    [STR_NTS_REQUIRE] = "Zahtevaj",
    [STR_WAITING_NTP] = "Čakanje na NTP...",
    [STR_FMT_SYNCED] = "Sinhr.: %s",
    [STR_FMT_SYNCING] = "Sinhroniziram: %s",
    [STR_FMT_WAITING] = "Čakanje: %lus",
    [STR_FMT_PEERS_NOSYNC] = "%d/%d strež.  poll %s  brez sync.",
    [STR_FMT_PEERS_AGO] = "%d/%d strež.  poll %s  pred %s",
    [STR_FMT_OFF_DRIFT] = "odmik %s %s drift %s",
    [STR_WIFI_SETUP] = "Nast. Wi-Fi",
    [STR_SCANNING] = "Iskanje...",
    [STR_SCAN_FAILED] = "Iskanje ni uspelo",
    [STR_TAP_RETRY] = "Tapnite znova",
    [STR_SELECT_NETWORK] = "Izberite omrežje",
    [STR_NO_NETWORKS] = "Ni omrežij",
    [STR_NETWORK_LABEL] = "Omrežje:",
    [STR_ENTER_PASSWORD] = "Vnesite geslo",
    [STR_CONNECTING] = "Povezujem",
    [STR_CONNECTING_TO] = "Povezujem z",
    [STR_CONNECTED] = "Povezano!",
    [STR_CONNECTION_FAILED] = "Povezava ni uspela",
    [STR_KB_SHIFT] = "Shift",
    [STR_KB_SPACE] = "Presledek",
    [STR_KB_GO] = "OK",
    [STR_VERSION] = "Različica:",
    [STR_FIRMWARE_URL] = "URL firmware:",
    [STR_OTA_URL] = "OTA URL",
    [STR_STATUS] = "Stanje:",
    [STR_READ] = "Prebrano:",
    [STR_UPDATE] = "Posodobi",
    [STR_RESTARTING] = "Ponovni zagon",
    [STR_OTA_UPDATE] = "OTA posodobitev",
    [STR_NTP_SERVER] = "Strežnik NTP",
    [STR_SERVER_LABEL] = "Strežnik:",
    [STR_NTP_SETTINGS] = "Nastavitve NTP",
    [STR_NTP_PRESETS] = "Profili NTP",
    [STR_PRESETS] = "Profili",
    [STR_BENCHMARK] = "Test",
    [STR_STOPPING] = "Ustavljam",
    [STR_FAIL] = "napaka",
    [STR_NTP_STATS] = "Statistika NTP",
    [STR_UNSYNCED] = "ni sync.",
    [STR_SYNCS_LABEL] = "  Sync.: ",
    [STR_AGE_LABEL] = "  Starost: ",
    [STR_NONE] = "brez",
    [STR_SELECT_REGION] = "Izberite regijo",
    [STR_DST] = "poletni čas",
    [STR_NO_DST] = "brez pol. časa",
};

static const char *const weekdays_sl[7] = {
    "ned.", "pon.", "tor.", "sre.", "čet.", "pet.", "sob.",
};

static const char *const months_sl[12] = {
    "jan.", "feb.", "mar.", "apr.", "maj", "jun.",
    "jul.", "avg.", "sep.", "okt.", "nov.", "dec.",
};

static const char lang_name_sl[] = "Slovenščina";
