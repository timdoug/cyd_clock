static const char *const lang_lv[STR_COUNT] = {
    [STR_SETTINGS] = "Iestatījumi",
    [STR_WIFI] = "Wi-Fi",
    [STR_TIMEZONE] = "Laika josla",
    [STR_BRIGHTNESS] = "Spilgtums",
    [STR_LED_BLINK] = "LED mirg.",
    [STR_ROTATE] = "Pagriezt 180",
    [STR_ABOUT] = "Par",
    [STR_LANGUAGE] = "Valoda",
    [STR_DONE] = "Gatavs",
    [STR_BACK] = "Atpakaļ",
    [STR_CANCEL] = "Atcelt",
    [STR_DEL] = "Dzēst",
    [STR_RUNNING] = "Darbojas",
    [STR_ON] = "Iesl.",
    [STR_OFF] = "Izsl.",
    [STR_WAITING_NTP] = "Gaida NTP...",
    [STR_WIFI_SETUP] = "Wi-Fi iestat.",
    [STR_SCANNING] = "Skenē...",
    [STR_SCAN_FAILED] = "Skenēšana neizdevās",
    [STR_TAP_RETRY] = "Pieskarieties vēlreiz",
    [STR_SELECT_NETWORK] = "Izvēlieties tīklu",
    [STR_NO_NETWORKS] = "Tīkli nav atrasti",
    [STR_NETWORK_LABEL] = "Tīkls:",
    [STR_ENTER_PASSWORD] = "Ievadiet paroli",
    [STR_CONNECTING] = "Savieno",
    [STR_CONNECTING_TO] = "Savieno ar",
    [STR_CONNECTED] = "Savienots!",
    [STR_CONNECTION_FAILED] = "Savienojums neizdevās",
    [STR_KB_SHIFT] = "Shift",
    [STR_KB_SPACE] = "Atstarpe",
    [STR_KB_GO] = "OK",
    [STR_VERSION] = "Versija:",
    [STR_FIRMWARE_URL] = "Firmware URL:",
    [STR_OTA_URL] = "OTA URL",
    [STR_STATUS] = "Statuss:",
    [STR_READ] = "Lasīts:",
    [STR_UPDATE] = "Atjaunināt",
    [STR_RESTARTING] = "Restartē",
    [STR_OTA_UPDATE] = "OTA atjaun.",
    [STR_NTP_SERVER] = "NTP serveris",
    [STR_SERVER_LABEL] = "Serveris:",
    [STR_NTP_SETTINGS] = "NTP iestatījumi",
    [STR_NTP_PRESETS] = "NTP profili",
    [STR_PRESETS] = "Profili",
    [STR_NONE] = "nav",
    [STR_SELECT_REGION] = "Izvēlieties reģionu",
    [STR_DST] = "vasaras laiks",
    [STR_NO_DST] = "bez vas. laika",
};

static const char *const weekdays_lv[7] = {
    "Sv", "Pr", "Ot", "Tr", "Ce", "Pk", "Se",
};

static const char *const months_lv[12] = {
    "janv.", "febr.", "marts", "apr.", "maijs", "jūn.",
    "jūl.", "aug.", "sept.", "okt.", "nov.", "dec.",
};

static const char lang_name_lv[] = "Latviešu";
