static const char *const lang_fr[STR_COUNT] = {
    [STR_SETTINGS] = "Réglages",
    [STR_WIFI] = "Wi-Fi",
    [STR_TIMEZONE] = "Fuseau horaire",
    [STR_BRIGHTNESS] = "Luminosité",
    [STR_LED_BLINK] = "LED Clign.",
    [STR_ROTATE] = "Rotation 180",
    [STR_ABOUT] = "Infos",
    [STR_LANGUAGE] = "Langue",
    [STR_DONE] = "OK",
    [STR_BACK] = "Retour",
    [STR_CANCEL] = "Annul.",
    [STR_DEL] = "Suppr",
    [STR_RUNNING] = "En cours",
    [STR_ON] = "Oui",
    [STR_OFF] = "Non",
    [STR_WAITING_NTP] = "Attente NTP...",
    [STR_WIFI_SETUP] = "Config. Wi-Fi",
    [STR_SCANNING] = "Recherche...",
    [STR_SCAN_FAILED] = "Scan échoué",
    [STR_TAP_RETRY] = "Touchez pour réessayer",
    [STR_SELECT_NETWORK] = "Choisir réseau",
    [STR_NO_NETWORKS] = "Aucun réseau",
    [STR_NETWORK_LABEL] = "Réseau:",
    [STR_ENTER_PASSWORD] = "Mot de passe",
    [STR_CONNECTING] = "Connexion",
    [STR_CONNECTING_TO] = "Connexion à",
    [STR_CONNECTED] = "Connecté !",
    [STR_CONNECTION_FAILED] = "Connexion échouée",
    [STR_KB_SHIFT] = "Maj",
    [STR_KB_SPACE] = "Espace",
    [STR_KB_GO] = "OK",
    [STR_VERSION] = "Version:",
    [STR_FIRMWARE_URL] = "URL firmware:",
    [STR_OTA_URL] = "URL OTA",
    [STR_STATUS] = "Statut:",
    [STR_READ] = "Lu:",
    [STR_UPDATE] = "M. à jour",
    [STR_RESTARTING] = "Redémarrage",
    [STR_OTA_UPDATE] = "MAJ OTA",
    [STR_NTP_SERVER] = "Serveur NTP",
    [STR_SERVER_LABEL] = "Serveur:",
    [STR_NTP_SETTINGS] = "Réglages NTP",
    [STR_NTP_PRESETS] = "Prédéf. NTP",
    [STR_PRESETS] = "Prédéfinis",
    [STR_NONE] = "aucune",  // refers to the IPv6 address (feminine)
    [STR_SELECT_REGION] = "Choisir région",
    [STR_DST] = "heure d'été",
    [STR_NO_DST] = "sans h. d'été",
};

static const char *const weekdays_fr[7] = {
    "dim.", "lun.", "mar.", "mer.", "jeu.", "ven.", "sam.",
};

static const char *const months_fr[12] = {
    "janv.", "févr.", "mars", "avr.", "mai", "juin",
    "juil.", "août", "sept.", "oct.", "nov.", "déc.",
};

static const char lang_name_fr[] = "Français";
