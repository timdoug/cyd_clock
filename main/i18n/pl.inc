static const char *const lang_pl[STR_COUNT] = {
    [STR_SETTINGS] = "Ustawienia",
    [STR_WIFI] = "Wi-Fi",
    [STR_TIMEZONE] = "Strefa czasowa",
    [STR_BRIGHTNESS] = "Jasność",
    [STR_LED_BLINK] = "Miganie LED",
    [STR_ROTATE] = "Obrót 180",
    [STR_ABOUT] = "O programie",
    [STR_LANGUAGE] = "Język",
    [STR_DONE] = "Gotowe",
    [STR_BACK] = "Wstecz",
    [STR_CANCEL] = "Anuluj",
    [STR_DEL] = "Usuń",
    [STR_RUNNING] = "Działa",
    [STR_ON] = "Tak",
    [STR_OFF] = "Nie",
    [STR_WAITING_NTP] = "Czekam na NTP...",
    [STR_WIFI_SETUP] = "Konfig. Wi-Fi",
    [STR_SCANNING] = "Skanowanie...",
    [STR_SCAN_FAILED] = "Skan nieudany",
    [STR_TAP_RETRY] = "Dotknij, by powt.",
    [STR_SELECT_NETWORK] = "Wybierz sieć",
    [STR_NO_NETWORKS] = "Brak sieci",
    [STR_NETWORK_LABEL] = "Sieć:",
    [STR_ENTER_PASSWORD] = "Hasło",
    [STR_CONNECTING] = "Łączenie",
    [STR_CONNECTING_TO] = "Łączenie z",
    [STR_CONNECTED] = "Połączono!",
    [STR_CONNECTION_FAILED] = "Błąd połączenia",
    [STR_KB_SHIFT] = "Shift",
    [STR_KB_SPACE] = "Spacja",
    [STR_KB_GO] = "OK",
    [STR_VERSION] = "Wersja:",
    [STR_FIRMWARE_URL] = "URL firmware:",
    [STR_OTA_URL] = "URL OTA",
    [STR_STATUS] = "Status:",
    [STR_READ] = "Odczyt:",
    [STR_UPDATE] = "Aktualizuj",
    [STR_RESTARTING] = "Restart",
    [STR_OTA_UPDATE] = "Aktualiz. OTA",
    [STR_NTP_SERVER] = "Serwer NTP",
    [STR_SERVER_LABEL] = "Serwer:",
    [STR_NTP_SETTINGS] = "Ustaw. NTP",
    [STR_NTP_PRESETS] = "Profile NTP",
    [STR_PRESETS] = "Profile",
    [STR_NONE] = "brak",
    [STR_SELECT_REGION] = "Wybierz region",
    [STR_DST] = "czas letni",
    [STR_NO_DST] = "bez czasu letn.",
};

static const char *const weekdays_pl[7] = {
    "niedz.", "pon.", "wt.", "śr.", "czw.", "pt.", "sob.",
};

static const char *const months_pl[12] = {
    "sty", "lut", "mar", "kwi", "maj", "cze",
    "lip", "sie", "wrz", "paź", "lis", "gru",
};

static const char lang_name_pl[] = "Polski";
