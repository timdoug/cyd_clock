static const char *const lang_sv[STR_COUNT] = {
    [STR_SETTINGS] = "Inställningar",
    [STR_WIFI] = "Wi-Fi",
    [STR_FAIL] = "fel",
    [STR_TIMEZONE] = "Tidszon",
    [STR_BRIGHTNESS] = "Ljusstyrka",
    [STR_LED_BLINK] = "LED-blink",
    [STR_ROTATE] = "Rotera 180",
    [STR_ABOUT] = "Om",
    [STR_LANGUAGE] = "Språk",
    [STR_DONE] = "Klar",
    [STR_BACK] = "Tillb.",
    [STR_CANCEL] = "Avbryt",
    [STR_DEL] = "Rad.",
    [STR_RUNNING] = "Kör",
    [STR_ON] = "På",
    [STR_OFF] = "Av",
    [STR_NTS_NO] = "Av",
    [STR_NTS_ATTEMPT] = "Prova",
    [STR_NTS_REQUIRE] = "Krav",
    [STR_WAITING_NTP] = "Väntar på NTP...",
    [STR_FMT_SYNCED] = "Synk.: %s",
    [STR_FMT_SYNCING] = "Synkar: %s",
    [STR_FMT_WAITING] = "Väntar: %lus",
    [STR_FMT_PEERS_NOSYNC] = "%d/%d srv  poll %s  ej synk",
    [STR_FMT_PEERS_AGO] = "%d/%d srv  poll %s  %s sedan",
    [STR_WIFI_SETUP] = "Wi-Fi-inst.",
    [STR_SCANNING] = "Söker...",
    [STR_SCAN_FAILED] = "Sökning misslyckades",
    [STR_TAP_RETRY] = "Tryck för nytt",
    [STR_SELECT_NETWORK] = "Välj nät",
    [STR_NO_NETWORKS] = "Inga nät",
    [STR_NETWORK_LABEL] = "Nät:",
    [STR_ENTER_PASSWORD] = "Lösenord",
    [STR_CONNECTING] = "Ansluter",
    [STR_CONNECTING_TO] = "Ansluter till",
    [STR_CONNECTED] = "Ansluten!",
    [STR_CONNECTION_FAILED] = "Anslutning misslyckades",
    [STR_KB_SHIFT] = "Skift",
    [STR_KB_SPACE] = "Mellanslag",
    [STR_KB_GO] = "OK",
    [STR_VERSION] = "Version:",
    [STR_FIRMWARE_URL] = "Firmware-URL:",
    [STR_OTA_URL] = "OTA-URL",
    [STR_STATUS] = "Status:",
    [STR_READ] = "Läst:",
    [STR_UPDATE] = "Uppdatera",
    [STR_RESTARTING] = "Startar om",
    [STR_OTA_UPDATE] = "OTA-uppdat.",
    [STR_NTP_SERVER] = "NTP-server",
    [STR_SERVER_LABEL] = "Server:",
    [STR_NTP_SETTINGS] = "NTP-inst.",
    [STR_NTP_PRESETS] = "NTP-förinst.",
    [STR_PRESETS] = "Förinst.",
    [STR_BENCHMARK] = "Mät",
    [STR_STOPPING] = "Stoppar",
    [STR_NTP_STATS] = "NTP-statistik",
    [STR_UNSYNCED] = "ej synk",
    [STR_SYNCS_LABEL] = "  Synk: ",
    [STR_AGE_LABEL] = "  Ålder: ",
    [STR_NONE] = "ingen",
    [STR_SELECT_REGION] = "Välj region",
    [STR_DST] = "sommartid",
    [STR_NO_DST] = "ej sommartid",
};

static const char *const weekdays_sv[7] = {
    "sön", "mån", "tis", "ons", "tors", "fre", "lör",
};

static const char *const months_sv[12] = {
    "jan.", "feb.", "mars", "apr.", "maj", "juni",
    "juli", "aug.", "sep.", "okt.", "nov.", "dec.",
};

static const char lang_name_sv[] = "Svenska";
