static const char *const lang_hu[STR_COUNT] = {
    [STR_SETTINGS] = "Beállítások",
    [STR_WIFI] = "Wi-Fi",
    [STR_TIMEZONE] = "Időzóna",
    [STR_BRIGHTNESS] = "Fényerő",
    [STR_LED_BLINK] = "LED Villog",
    [STR_ROTATE] = "Forgat 180",
    [STR_ABOUT] = "Info",
    [STR_LANGUAGE] = "Nyelv",
    [STR_DONE] = "Kész",
    [STR_BACK] = "Vissza",
    [STR_CANCEL] = "Mégse",
    [STR_DEL] = "Törl",
    [STR_RUNNING] = "Fut",
    [STR_ON] = "Be",
    [STR_OFF] = "Ki",
    [STR_NTS_NO] = "Nem",
    [STR_NTS_ATTEMPT] = "Próba",
    [STR_NTS_REQUIRE] = "Kőt.",
    [STR_WAITING_NTP] = "Várakozás NTP...",
    [STR_FMT_SYNCED] = "Szinkr.: %s",
    [STR_FMT_SYNCING] = "Szinkr...: %s",
    [STR_FMT_WAITING] = "Várás: %lus",
    [STR_FMT_PEERS_NOSYNC] = "%d/%d srv  poll %s  nincs szinkr",
    [STR_FMT_PEERS_AGO] = "%d/%d srv  poll %s  %s ezelőtt",
    [STR_WIFI_SETUP] = "Wi-Fi beáll.",
    [STR_SCANNING] = "Keresés...",
    [STR_SCAN_FAILED] = "Sken hiba",
    [STR_TAP_RETRY] = "Koppints ism.",
    [STR_SELECT_NETWORK] = "Válassz hálót",
    [STR_NO_NETWORKS] = "Nincs hálózat",
    [STR_NETWORK_LABEL] = "Hálózat:",
    [STR_ENTER_PASSWORD] = "Jelszó",
    [STR_CONNECTING] = "Csatlakozás",
    [STR_CONNECTING_TO] = "Csatlakozás:",
    [STR_CONNECTED] = "Csatlakozva!",
    [STR_CONNECTION_FAILED] = "Sikertelen kapcs.",
    [STR_KB_SHIFT] = "Shift",
    [STR_KB_SPACE] = "Szóköz",
    [STR_KB_GO] = "OK",
    [STR_VERSION] = "Verzió:",
    [STR_FIRMWARE_URL] = "Firmware URL:",
    [STR_STATUS] = "Státusz:",
    [STR_READ] = "Olvasva:",
    [STR_UPDATE] = "Frissít",
    [STR_RESTARTING] = "Restart",
    [STR_OTA_UPDATE] = "OTA friss.",
    [STR_NTP_SERVER] = "NTP szerver",
    [STR_SERVER_LABEL] = "Szerver:",
    [STR_NTP_SETTINGS] = "NTP beáll.",
    [STR_NTP_PRESETS] = "NTP profilok",
    [STR_PRESETS] = "Profilok",
    [STR_BENCHMARK] = "Mérés",
    [STR_STOPPING] = "Leáll.",
    [STR_NTP_STATS] = "NTP statisztika",
    [STR_UNSYNCED] = "nincs sync",
    [STR_STRATUM_LABEL] = "Réteg: ",
    [STR_SYNCS_LABEL] = "  Szink: ",
    [STR_AGE_LABEL] = "  Kor: ",
    [STR_NONE] = "nincs",
    [STR_SELECT_REGION] = "Válassz régiót",
    [STR_DST] = "nyári idő",
    [STR_NO_DST] = "nincs nyári idő",
    [STR_FAIL] = "hiba",
};

static const char *const weekdays_hu[7] = {
    "V", "H", "K", "Sze", "Cs", "P", "Szo",
};

static const char *const months_hu[12] = {
    "jan.", "febr.", "márc.", "ápr.", "máj.", "jún.",
    "júl.", "aug.", "szept.", "okt.", "nov.", "dec.",
};

static const char lang_name_hu[] = "Magyar";
