static const char *const lang_pt[STR_COUNT] = {
    [STR_SETTINGS] = "Definições",
    [STR_WIFI] = "Wi-Fi",
    [STR_FAIL] = "falha",
    [STR_TIMEZONE] = "Fuso horário",
    [STR_BRIGHTNESS] = "Brilho",
    [STR_LED_BLINK] = "LED Pisca",
    [STR_ROTATE] = "Girar 180",
    [STR_ABOUT] = "Sobre",
    [STR_LANGUAGE] = "Idioma",
    [STR_DONE] = "OK",
    [STR_BACK] = "Voltar",
    [STR_CANCEL] = "Canc.",
    [STR_DEL] = "Apg",
    [STR_RUNNING] = "Em exec.",
    [STR_ON] = "Sim",
    [STR_OFF] = "Não",
    [STR_NTS_NO] = "Não",
    [STR_NTS_ATTEMPT] = "Tentar",
    [STR_NTS_REQUIRE] = "Exigir",
    [STR_WAITING_NTP] = "Aguardando NTP...",
    [STR_FMT_SYNCED] = "Sinc.: %s",
    [STR_FMT_SYNCING] = "Sinc...: %s",
    [STR_FMT_WAITING] = "Espera: %lus",
    [STR_FMT_PEERS_NOSYNC] = "%d/%d serv  poll %s  sem sinc",
    [STR_FMT_PEERS_AGO] = "%d/%d serv  poll %s  há %s",
    [STR_WIFI_SETUP] = "Config. Wi-Fi",
    [STR_SCANNING] = "Procurando...",
    [STR_SCAN_FAILED] = "Falha na busca",
    [STR_TAP_RETRY] = "Toque p/ tentar",
    [STR_SELECT_NETWORK] = "Escolha a rede",
    [STR_NO_NETWORKS] = "Nenhuma rede",
    [STR_NETWORK_LABEL] = "Rede:",
    [STR_ENTER_PASSWORD] = "Senha",
    [STR_CONNECTING] = "Conectando",
    [STR_CONNECTING_TO] = "Conectando a",
    [STR_CONNECTED] = "Conectado!",
    [STR_CONNECTION_FAILED] = "Falha na conexão",
    [STR_KB_SHIFT] = "Mai",
    [STR_KB_SPACE] = "Espaço",
    [STR_KB_GO] = "Ir",
    [STR_VERSION] = "Versão:",
    [STR_FIRMWARE_URL] = "URL firmware:",
    [STR_OTA_URL] = "URL OTA",
    [STR_STATUS] = "Estado:",
    [STR_READ] = "Lido:",
    [STR_UPDATE] = "Atualizar",
    [STR_RESTARTING] = "Reiniciando",
    [STR_OTA_UPDATE] = "Atualiz. OTA",
    [STR_NTP_SERVER] = "Servidor NTP",
    [STR_SERVER_LABEL] = "Servidor:",
    [STR_NTP_SETTINGS] = "Definições NTP",
    [STR_NTP_PRESETS] = "Predef. NTP",
    [STR_PRESETS] = "Predefinidos",
    [STR_BENCHMARK] = "Medir",
    [STR_STOPPING] = "Parando",
    [STR_NTP_STATS] = "Estat. NTP",
    [STR_UNSYNCED] = "sem sinc",
    [STR_SYNCS_LABEL] = "  Sinc.: ",
    [STR_AGE_LABEL] = "  Idade: ",
    [STR_NONE] = "nenhum",
    [STR_SELECT_REGION] = "Escolha região",
    [STR_DST] = "h. de verão",
    [STR_NO_DST] = "sem h. de verão",
};

static const char *const weekdays_pt[7] = {
    "dom.", "seg.", "ter.", "qua.", "qui.", "sex.", "sáb.",
};

static const char *const months_pt[12] = {
    "jan.", "fev.", "mar.", "abr.", "mai.", "jun.",
    "jul.", "ago.", "set.", "out.", "nov.", "dez.",
};

static const char lang_name_pt[] = "Português";
