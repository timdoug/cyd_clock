static const char *const lang_lt[STR_COUNT] = {
    [STR_SETTINGS] = "Nustatymai",
    [STR_WIFI] = "Wi-Fi",
    [STR_TIMEZONE] = "Laiko juosta",
    [STR_BRIGHTNESS] = "Ryškumas",
    [STR_LED_BLINK] = "LED mirks.",
    [STR_ROTATE] = "Pasukti 180",
    [STR_ABOUT] = "Apie",
    [STR_LANGUAGE] = "Kalba",
    [STR_DONE] = "Atlikta",
    [STR_BACK] = "Atgal",
    [STR_CANCEL] = "Atšaukti",
    [STR_DEL] = "Trinti",
    [STR_RUNNING] = "Veikia",
    [STR_ON] = "Įjungta",
    [STR_OFF] = "Išjungta",
    [STR_NTS_NO] = "Ne",
    [STR_NTS_ATTEMPT] = "Bandyti",
    [STR_NTS_REQUIRE] = "Reikalauti",
    [STR_WAITING_NTP] = "Laukiama NTP...",
    [STR_FMT_SYNCED] = "Sinchr.: %s",
    [STR_FMT_SYNCING] = "Sinchroniz.: %s",
    [STR_FMT_WAITING] = "Laukiama: %lus",
    [STR_FMT_PEERS_NOSYNC] = "%d/%d serv.  poll %s  nėra sync.",
    [STR_FMT_PEERS_AGO] = "%d/%d serv.  poll %s  prieš %s",
    [STR_FMT_OFF_DRIFT] = "nuokr. %s %s drift %s",
    [STR_WIFI_SETUP] = "Wi-Fi nust.",
    [STR_SCANNING] = "Ieškoma...",
    [STR_SCAN_FAILED] = "Paieška nepavyko",
    [STR_TAP_RETRY] = "Bakstelėkite dar",
    [STR_SELECT_NETWORK] = "Pasirinkite tinklą",
    [STR_NO_NETWORKS] = "Tinklų nerasta",
    [STR_NETWORK_LABEL] = "Tinklas:",
    [STR_ENTER_PASSWORD] = "Įveskite slaptaž.",
    [STR_CONNECTING] = "Jungiama",
    [STR_CONNECTING_TO] = "Jungiama prie",
    [STR_CONNECTED] = "Prisijungta!",
    [STR_CONNECTION_FAILED] = "Prisijungti nepavyko",
    [STR_KB_SHIFT] = "Shift",
    [STR_KB_SPACE] = "Tarpas",
    [STR_KB_GO] = "OK",
    [STR_VERSION] = "Versija:",
    [STR_FIRMWARE_URL] = "Firmware URL:",
    [STR_OTA_URL] = "OTA URL",
    [STR_STATUS] = "Būsena:",
    [STR_READ] = "Skaityta:",
    [STR_UPDATE] = "Atnaujinti",
    [STR_RESTARTING] = "Paleidžiama iš naujo",
    [STR_OTA_UPDATE] = "OTA naujinimas",
    [STR_NTP_SERVER] = "NTP serveris",
    [STR_SERVER_LABEL] = "Serveris:",
    [STR_NTP_SETTINGS] = "NTP nustatymai",
    [STR_NTP_PRESETS] = "NTP profiliai",
    [STR_PRESETS] = "Profiliai",
    [STR_BENCHMARK] = "Testas",
    [STR_STOPPING] = "Stabdoma",
    [STR_FAIL] = "klaida",
    [STR_NTP_STATS] = "NTP statistika",
    [STR_UNSYNCED] = "be sync.",
    [STR_SYNCS_LABEL] = "  Sync.: ",
    [STR_AGE_LABEL] = "  Amžius: ",
    [STR_NONE] = "nėra",
    [STR_SELECT_REGION] = "Pasirinkite regioną",
    [STR_DST] = "vasaros laikas",
    [STR_NO_DST] = "be vas. laiko",
};

static const char *const weekdays_lt[7] = {
    "sk", "pr", "an", "tr", "kt", "pn", "št",
};

static const char *const months_lt[12] = {
    "saus.", "vas.", "kov.", "bal.", "geg.", "birž.",
    "liep.", "rugp.", "rugs.", "spal.", "lapkr.", "gruod.",
};

static const char lang_name_lt[] = "Lietuvių";
