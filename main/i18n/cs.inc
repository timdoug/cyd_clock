static const char *const lang_cs[STR_COUNT] = {
    [STR_SETTINGS] = "Nastavení",
    [STR_WIFI] = "Wi-Fi",
    [STR_TIMEZONE] = "Pásmo",
    [STR_BRIGHTNESS] = "Jas",
    [STR_LED_BLINK] = "LED Blik",
    [STR_ROTATE] = "Otočit 180",
    [STR_ABOUT] = "O aplikaci",
    [STR_LANGUAGE] = "Jazyk",
    [STR_DONE] = "Hotovo",
    [STR_BACK] = "Zpět",
    [STR_CANCEL] = "Zrušit",
    [STR_DEL] = "Smaz.",  // "Smazat" (6 ch) overflows the 5-ch kb Del key
    [STR_RUNNING] = "Běží",
    [STR_ON] = "Ano",
    [STR_OFF] = "Ne",
    [STR_WAITING_NTP] = "Čekání na NTP...",
    [STR_WIFI_SETUP] = "Nastav. Wi-Fi",
    [STR_SCANNING] = "Hledání...",
    [STR_SCAN_FAILED] = "Sken selhal",
    [STR_TAP_RETRY] = "Klepněte pro opak.",
    [STR_SELECT_NETWORK] = "Vyberte síť",
    [STR_NO_NETWORKS] = "Bez sítí",
    [STR_NETWORK_LABEL] = "Síť:",
    [STR_ENTER_PASSWORD] = "Heslo",
    [STR_CONNECTING] = "Připojování",
    [STR_CONNECTING_TO] = "Připojuji k",
    [STR_CONNECTED] = "Připojeno!",
    [STR_CONNECTION_FAILED] = "Chyba připojení",
    [STR_KB_SHIFT] = "Shift",
    [STR_KB_SPACE] = "Mezera",
    [STR_KB_GO] = "OK",
    [STR_VERSION] = "Verze:",
    [STR_FIRMWARE_URL] = "URL firmware:",
    [STR_OTA_URL] = "URL OTA",
    [STR_STATUS] = "Stav:",
    [STR_READ] = "Načteno:",
    [STR_UPDATE] = "Aktualiz.",
    [STR_RESTARTING] = "Restart",
    [STR_OTA_UPDATE] = "Aktualiz. OTA",
    [STR_NTP_SERVER] = "Server NTP",
    [STR_SERVER_LABEL] = "Server:",
    [STR_NTP_SETTINGS] = "Nastav. NTP",
    [STR_NTP_PRESETS] = "Profily NTP",
    [STR_PRESETS] = "Profily",
    [STR_NONE] = "žádná",  // "zadna": the IPv6 address (feminine), lowercase like other langs
    [STR_SELECT_REGION] = "Vyberte region",
    [STR_DST] = "letní čas",
    [STR_NO_DST] = "bez let. času",
};

static const char *const weekdays_cs[7] = {
    "ne", "po", "út", "st", "čt", "pá", "so",
};

static const char *const months_cs[12] = {
    "led", "úno", "bře", "dub", "kvě", "čvn",
    "čvc", "srp", "zář", "říj", "lis", "pro",
};

static const char lang_name_cs[] = "Čeština";
